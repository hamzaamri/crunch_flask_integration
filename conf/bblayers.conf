## conf/bblayers.conf
```bitbake
# POKY_BBLAYERS_CONF_VERSION is increased each time build/conf/bblayers.conf
# changes incompatibly
POKY_BBLAYERS_CONF_VERSION = "2"

BBPATH = "${TOPDIR}"
BBFILES ?= ""

BBLAYERS ?= " \
  /home/hamza/poky/meta \
  /home/hamza/poky/meta-poky \
  /home/hamza/poky/meta-yocto-bsp \
  /home/hamza/project/chat-app/meta-crunch \
  "
```

## meta-crunch/conf/distro/app-distro.conf
```bitbake
require conf/distro/poky.conf
DISTRO = "app-distro"
DISTRO_NAME = "Custom distro for Crunch application"
DISTRO_VERSION = "0.1"
DISTRO_CODENAME = "kirkstone"
```

## meta-crunch/conf/layer.conf
```bitbake
# We have a conf and classes directory, add to BBPATH
BBPATH .= ":${LAYERDIR}"

# We have recipes-* directories, add to BBFILES
BBFILES += "${LAYERDIR}/recipes-*/*/*.bb \
            ${LAYERDIR}/recipes-*/*/*.bbappend"

BBFILE_COLLECTIONS += "meta-crunch"
BBFILE_PATTERN_meta-crunch = "^${LAYERDIR}/"
BBFILE_PRIORITY_meta-crunch = "6"

LAYERDEPENDS_meta-crunch = "core"
LAYERSERIES_COMPAT_meta-crunch = "kirkstone"
```
